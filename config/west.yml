## config/west.yml
```yaml
manifest:
  remotes:
    - name: zmkfirmware
      url-base: https://github.com/zmkfirmware
    - name: infely                             # new entry
      url-base: https://github.com/infely      # new entry
    - name: gpeye                         #new entry
      url-base: https://github.com/GPeye  # 1-bit art upgrade
      
  projects:
    - name: zmk
      remote: zmkfirmware
      revision: v0.2
      import: app/west.yml
    - name: nice-view-battery                  # new entry
      remote: infely                           # new entry
      revision: main    
    - name: hammerbeam-slideshow          #new entry
      remote: gpeye                       #new entry
      revision: main # new entry
  self:
    path: config
```
